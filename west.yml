## west.yml
```yaml
# SPDX-License-Identifier: Apache-2.0

manifest:
  remotes:
    - name: dozack
      url-base: https://github.com/dozack
  projects:
    - name: zephyr
      remote: dozack
      west-commands: scripts/west-commands.yml
      revision: subsys-canbus-j1939
  self:
    path: zbench
```
